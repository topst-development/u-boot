// SPDX-License-Identifier: (GPL-2.0-or-later OR MIT)
/*
 * Copyright (C) 2023 Telechips Inc.
 */

/ {
	sdhc0: sdhc@15200000 {
		compatible = "telechips,tcc750x-sdhci";
		reg = <0x15200000 0x100>,
		      <0x15210000 0x50>,
		      <0x152100FC 0x30>,
		      <0x1521012C 0x24>;
		max-frequency = <50000000>;
		bus-width = <4>;
		controller-id = <0>;
		status = "disabled";
	};
};

