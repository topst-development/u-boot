// SPDX-License-Identifier: (GPL-2.0-or-later OR MIT)
/*
 * Copyright (C) 2023 Telechips Inc.
 */

/ {
	hsm_mbox0: mailbox@0x14010000 {
		compatible = "telechips,sss-mailbox";
		status = "disabled";
		reg = <0x14010000 0x4000>;
		#mbox-cells = <1>;
		u-boot,dm-pre-reloc;
	};

	tcc_hsm_fw: tcc_hsm_fw {
		compatible = "telechips,tcc_hsm_fw";
		status = "disabled";
		u-boot,dm-pre-reloc;
	};
};
