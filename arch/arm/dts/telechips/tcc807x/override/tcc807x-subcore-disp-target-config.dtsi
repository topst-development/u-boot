// SPDX-License-Identifier: (GPL-2.0-or-later OR MIT)
/*
 * Copyright (C) 2023 Telechips Inc.
 */
#include <dt-bindings/display/telechips-common-fb_dm_display.h>

/* 1. Defination for Displayport configuration */
#define DPCFG_PANEL_MODE PANEL_MODE_ON

/* Defination for Displayport Video Identification Code */
#define DPCFG_DP0_VIC CUSTOM_VIC_1028
#define DPCFG_DP1_VIC CUSTOM_VIC_1028
#define DPCFG_DP2_VIC CUSTOM_VIC_1028
#define DPCFG_DP3_VIC CUSTOM_VIC_1028

#define DPCFG_DP0_VCP VCP_ID_1
#define DPCFG_DP1_VCP VCP_ID_2
#define DPCFG_DP2_VCP VCP_ID_3
#define DPCFG_DP3_VCP VCP_ID_4

#define DPCFG_SDM SDM_BYPASS_ENABLE
#define DPCFG_TRVC TRVC_BYPASS_ENABLE
#define DPCFG_ENCODING PIXEL_ENCODING_RGB
#define DPCFG_MAX_LANE PHY_LINK_LANE_4
#define DPCFG_RATE PHY_LINK_RATE_HBR3

/* 2. Defination for DSI configuration */
#define DSI0_PANEL_INDEX 1 /* 0: BOE PANEL, 1: AUO PANEL */

#define DSI1_PANEL_INDEX 1 /* 0: BOE PANEL, 1: AUO PANEL */

