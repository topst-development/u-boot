// SPDX-License-Identifier: (GPL-2.0-or-later OR MIT)
/*
 * Copyright (C) 2023 Telechips Inc.
 */

/ {
	tcc_sc_mmc: tcc_sc_mmc {
		compatible = "telechips,tcc807x-sc-mmc";
		non-removable;
		mmc-hs200-1_8v;
		mmc-hs400-1_8v;
		mmc-hs400-enhanced-strobe;
		bus-width = <8>;
		max-frequency = <200000000>;
		status = "disabled";
		u-boot,dm-pre-reloc;
	};
};
