// SPDX-License-Identifier: (GPL-2.0-or-later OR MIT)
/*
 * Copyright (C) 2023 Telechips Inc.
 */

/ {
	tcc_sc_ufs: tcc_sc_ufs {
		compatible = "telechips,tcc807x-sc-ufs";
		status = "disabled";
		u-boot,dm-pre-reloc;
	};
};
