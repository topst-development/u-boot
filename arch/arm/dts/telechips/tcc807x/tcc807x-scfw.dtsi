// SPDX-License-Identifier: (GPL-2.0-or-later OR MIT)
/*
 * Copyright (C) 2023 Telechips Inc.
 */

/ {
	tcc_sc_fw: tcc_sc_fw {
		compatible = "telechips,tcc807x-sc-fw";
		status = "disabled";
		u-boot,dm-pre-reloc;
	};
};
