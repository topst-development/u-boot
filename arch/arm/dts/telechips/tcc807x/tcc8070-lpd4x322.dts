// SPDX-License-Identifier: (GPL-2.0-or-later OR MIT)
/*
 * Copyright (C) 2023 Telechips Inc.
 */

/dts-v1/;

#include <dt-bindings/board/telechips.h>

#include "tcc807x.dts"

/ {
	model = "Telechips TCC8070 LPD4X322 Main Core";
	board-id = <BOARD_ID_TCC8070_EVB>;
	board-rev = <0x0>;
};

#include "override/tcc807x-mbox.dtsi"
#include "override/tcc807x-hsmfw.dtsi"
#include "override/tcc807x-scfw.dtsi"
#include "override/tcc807x-mmc.dtsi"
#include "override/tcc807x-ufs.dtsi"
#include "override/tcc8070-lpd4x322-uart.dtsi"
#include "override/tcc8070-lpd4x322-i2c.dtsi"
#include "override/tcc8070-lpd4x322-pcie.dtsi"

#include "override/tcc8070-lpd4x322-display.dts"
