// SPDX-License-Identifier: (GPL-2.0-or-later OR MIT)
/*
 * Copyright (C) 2023 Telechips Inc.
 */

/dts-v1/;

#include <dt-bindings/board/telechips.h>

#include "tcn100x.dts"

/ {
	model = "Telechips TCN1000 LPD4X321";
	board-id = <BOARD_ID_TCN1000_EVB>;
	board-rev = <0x0>;
};

#include "override/tcn100x-adc.dtsi"
#include "override/tcn1000-lpd4x321-uart.dtsi"
#include "override/tcn1000-lpd4x321-mmc.dtsi"
