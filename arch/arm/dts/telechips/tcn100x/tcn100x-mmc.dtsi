// SPDX-License-Identifier: (GPL-2.0-or-later OR MIT)
/*
 * Copyright (C) 2023 Telechips Inc.
 */

/ {
	sdhc0: sdhc@48000000 {
		compatible = "telechips,tcn100x-sdhci";
		reg = <0x0 0x48000000 0x0 0x100>,
		      <0x0 0x48010000 0x0 0x50>,
		      <0x0 0x480100FC 0x0 0x30>,
		      <0x0 0x4801012C 0x0 0x24>;
		max-frequency = <50000000>;
		bus-width = <4>;
		controller-id = <0>;
		status = "disabled";
	};
};

