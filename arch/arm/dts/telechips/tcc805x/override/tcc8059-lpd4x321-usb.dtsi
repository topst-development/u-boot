// SPDX-License-Identifier: (GPL-2.0-or-later OR MIT)
/*
 * Copyright (C) Telechips Inc.
 */

&ehci {
	use_expander;
	gpios = <&gpext1 4 0>;
};

&ehci_mux {
	use_expander;
	gpios = <&gpext1 5 0>;
};

&dwc_otg {
	use_expander;
	gpios = <&gpext1 5 0>;
};

&dwc3 {
	use_expander;
	gpios = <&gpext1 3 0>;
};
