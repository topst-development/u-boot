// SPDX-License-Identifier: (GPL-2.0-or-later OR MIT)
/*
 * Copyright (C) 2023 Telechips Inc.
 */

/dts-v1/;

#include <dt-bindings/board/telechips.h>

#include "tcc805x.dts"

/ {
	model = "Telechips TCC8053 LPD4X322 0.1 Main Core";
	board-id = <BOARD_ID_TCC8053_EVB>;
	board-rev = <0x0>;
};

#include "override/tcc805x-mbox.dtsi"
#include "override/tcc805x-hsmfw.dtsi"
#include "override/tcc805x-scfw.dtsi"
#include "override/tcc805x-mmc.dtsi"
#include "override/tcc805x-ufs.dtsi"
#include "override/tcc8050_53-lpd4x322-uart.dtsi"
#include "override/tcc8050_53-lpd4x322-sv0.1-i2c.dtsi"
#include "override/tcc8050_53-lpd4x322-sv0.1-usb.dtsi"
#include "override/tcc8050_53-lpd4x322-sv0.1-pcie.dtsi"

#include "override/tcc8053-cluster-lpd4x322-sv0.1-display.dts"
