// SPDX-License-Identifier: (GPL-2.0-or-later OR MIT)
/*
 * Copyright (C) 2023 Telechips Inc.
 */

/ {
	dwc_pcie_phy: dwc_pcie_phy@11100000 {
		compatible = "telechips,dwc_pcie_phy";
		reg = <0x11100000 0xB0>;
		#phy-cells = <0>;
		status = "disabled";
	};

	pcie: pcie@11000000 {
		compatible = "telechips,pcie-rc";
		reg = <0x11000000 0x410000>,
			<0x11110000 0x10000>,
			<0x11120000 0x10000>,
			<0x00000000 0x100000>;
		reg-names = "dbi", "clk", "link", "config";
		#address-cells = <3>;
		#size-cells = <1>;
		device_type = "pci";
		ranges = <0x81000000 0 0x00100000 0x00100000 0x00100000  /* downstream I/O */
			0x82000000 0 0x00200000 0x00200000 0x00100000>;   /* non-prefetchable memory*/
		max_link_speed = <3>;
		pms = <0x0504C80C>;
		phys = <&dwc_pcie_phy>;
		phy-names = "pcie_phy";
		pinctrl-names = "pcie_rst_on", "pcie_rst_off";
		status = "disabled";
	};
};
