// SPDX-License-Identifier: (GPL-2.0-or-later OR MIT)
/*
 * Copyright (C) 2023 Telechips Inc.
 */

/dts-v1/;

#include "tcc805x-subcore.dts"

/ {
	model = "Telechips TCC8050 LPD4X322 1.0 Sub-Core";
};

#include "override/tcc805x-subcore-uart.dtsi"
#include "override/tcc805x-subcore-mbox.dtsi"
#include "override/tcc805x-subcore-scfw.dtsi"
#include "override/tcc805x-subcore-hsmfw.dtsi"
#include "override/tcc805x-mmc.dtsi"
#include "override/tcc805x-ufs.dtsi"
#include "override/tcc805x-subcore-i2c.dtsi"
#include "override/tcc805x-subcore-pwm.dtsi"
#include "override/tcc8050-subcore-lpd4x322-sv1.0-display.dts"