// SPDX-License-Identifier: (GPL-2.0-or-later OR MIT)
/*
 * Copyright (C) 2023 Telechips Inc.
 */

/dts-v1/;

#include <dt-bindings/board/telechips.h>

#include "tcc805x.dts"

/ {
	model = "Telechips TCC8050 TOPST D3-G 1.0 Main Core";
	board-id = <BOARD_ID_TCC8050_TOPST>;
	board-rev = <0x0>;
};

#include "override/tcc805x-mbox.dtsi"
#include "override/tcc805x-hsmfw.dtsi"
#include "override/tcc805x-scfw.dtsi"
#include "override/tcc805x-mmc.dtsi"
#include "override/tcc805x-ufs.dtsi"
#include "override/topst-d3-g-uart.dtsi"
#include "override/topst-d3-g-i2c.dtsi"
#include "override/topst-d3-g-usb.dtsi"
#include "override/topst-d3-g-gmac.dtsi"
