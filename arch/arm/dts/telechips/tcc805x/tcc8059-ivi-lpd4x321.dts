// SPDX-License-Identifier: (GPL-2.0-or-later OR MIT)
/*
 * Copyright (C) 2023 Telechips Inc.
 */

/dts-v1/;

#include <dt-bindings/board/telechips.h>

#include "tcc805x.dts"

/ {
	model = "Telechips TCC8059 LPD4X321 Main Core";
	board-id = <BOARD_ID_TCC8059_EVB>;
	board-rev = <0x0>;
};

#include "override/tcc805x-mbox.dtsi"
#include "override/tcc805x-hsmfw.dtsi"
#include "override/tcc805x-scfw.dtsi"
#include "override/tcc805x-mmc.dtsi"
#include "override/tcc8059-lpd4x321-uart.dtsi"
#include "override/tcc8059-lpd4x321-i2c.dtsi"
#include "override/tcc8059-lpd4x321-usb.dtsi"
#include "override/tcc8059-lpd4x321-pcie.dtsi"

#include "override/tcc8059-lpd4x321-display.dts"
