// SPDX-License-Identifier: (GPL-2.0-or-later OR MIT)
/*
 * Copyright (C) 2023 Telechips Inc.
 */

/dts-v1/;

#include <dt-bindings/board/telechips.h>

#include "tcc805x.dts"

/ {
	model = "Telechips TCC8050 LPD4X322 1.0 Main Core";
	board-id = <BOARD_ID_TCC8050_EVB>;
	board-rev = <0x1>;
};

#include "override/tcc805x-mbox.dtsi"
#include "override/tcc805x-hsmfw.dtsi"
#include "override/tcc805x-scfw.dtsi"
#include "override/tcc805x-mmc.dtsi"
#include "override/tcc805x-ufs.dtsi"
#include "override/tcc8050_53-lpd4x322-uart.dtsi"
#include "override/tcc8050_53-lpd4x322-sv1.0-i2c.dtsi"
#include "override/tcc8050_53-lpd4x322-sv1.0-usb.dtsi"
#include "override/tcc8050_53-lpd4x322-sv1.0-pcie.dtsi"
#include "override/tcc8050_53-lpd4x322-sv1.0-gmac.dtsi"

#include "override/tcc8050-cluster-lpd4x322-sv1.0-display.dts"
