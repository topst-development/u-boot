// SPDX-License-Identifier: (GPL-2.0-or-later OR MIT)
/*
 * Copyright (C) 2023 Telechips Inc.
 */

/dts-v1/;

#include <dt-bindings/board/telechips.h>

#include "tcc805x-subcore.dts"

/ {
	model = "Telechips TCC8050 TOPST D3-G 1.0 Sub-Core";
	board-id = <BOARD_ID_TCC8050_TOPST>;
	board-rev = <0x0>;
};

#include "override/tcc805x-subcore-mbox.dtsi"
#include "override/tcc805x-subcore-hsmfw.dtsi"
#include "override/tcc805x-subcore-scfw.dtsi"
#include "override/tcc805x-mmc.dtsi"
#include "override/tcc805x-ufs.dtsi"
#include "override/topst-d3-g-subcore-uart.dtsi"
#include "override/topst-d3-g-subcore-i2c.dtsi"
