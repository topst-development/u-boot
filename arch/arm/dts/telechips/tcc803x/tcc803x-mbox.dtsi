// SPDX-License-Identifier: (GPL-2.0-or-later OR MIT)
/*
 * Copyright (C) 2023 Telechips Inc.
 */

/ {
	/* micom sub-system mailbox for ca53 */
	mbox0: mailbox@1BA100000 {
		compatible = "telechips,tcc803x-mailbox";
		status = "disabled";
		reg = <0x1BA10000 0x80>;
		#mbox-cells = <1>;
		u-boot,dm-pre-reloc;
	};
};
