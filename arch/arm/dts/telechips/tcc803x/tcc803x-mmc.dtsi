// SPDX-License-Identifier: (GPL-2.0-or-later OR MIT)
/*
 * Copyright (C) 2023 Telechips Inc.
 */

/{
	sdhc0: sdhc@0x16440000 {
		compatible = "telechips,tcc803x-sdhci";
		reg = <0x16440000 0x100>,
		      <0x16470000 0x50>,
		      <0x164700FC 0x30>,
		      <0x1647012C 0x24>;
		max-frequency = <50000000>;
		bus-width = <4>;
		controller-id = <0>;
		status = "disabled";
	};

	sdhc1: sdhc@16450000 {
		compatible = "telechips,tcc803x-sdhci";
		reg = <0x16450000 0x100>,
		      <0x16470050 0x50>,
		      <0x164700FC 0x30>,
		      <0x16470150 0x24>;
		max-frequency = <50000000>;
		bus-width = <4>;
		controller-id = <1>;
		status = "disabled";
	};

	sdhc2: sdhc@16460000 {
		compatible = "telechips,tcc803x-sdhci";
		reg = <0x16460000 0x100>,
		      <0x164700A0 0x50>,
		      <0x164700FC 0x30>,
		      <0x16470174 0x24>;
		max-frequency = <50000000>;
		bus-width = <4>;
		controller-id = <2>;
		status = "disabled";
	};
};

