// SPDX-License-Identifier: (GPL-2.0-or-later OR MIT)
/*
 * Copyright (C) 2023 Telechips Inc.
 */

/ {
	cpus: cpus {
		compatible = "cpu_bus";
		u-boot,dm-pre-reloc;

		cpu0: cpu@0 {
			compatible = "arm,cortex-a53";
			device_type = "cpu";
		};
	};

	gic: interrupt-controller@17301000 {
		compatible = "arm,gic-400", "telechips,tcc803x-vpic";
		#interrupt-cells = <3>;
		#address-cells = <0>;
		interrupt-controller;
		reg = <0x17301000 0x1000>,
		      <0x17302000 0x1000>,
		      <0x17304000 0x2000>,
		      <0x17306000 0x2000>,
		      <0x141000E0 0x18>,
		      <0x14600100 0x24>;
	};
};
