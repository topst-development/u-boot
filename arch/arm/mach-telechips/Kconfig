## arch/arm/mach-telechips/Kconfig
```kconfig
# SPDX-License-Identifier: GPL-2.0-or-later
#
# Copyright (C) 2023 Telechips Inc.

menu "Telechips architecture"
	depends on ARCH_TELECHIPS

config SYS_VENDOR
	default "telechips"

config HAS_SUBCORE
	bool

config ARCH_SUPPORT_BOOT_SUBCORE_BY_MAINCORE
	bool

choice
	prompt "Telechips SoC select"
	optional

config TCC750X
	bool "Telechips TCC750x SoC Family"
	select ARM_SMCCC
	select USE_IRQ

config TCC803X
	bool "Telechips TCC803x SoC family"
	select ARM_SMCCC
	select USE_IRQ
	select HAS_SUBCORE
	select ARCH_REBOOT_INIT
	select ARCH_SUPPORT_BOOT_SUBCORE_BY_MAINCORE

config TCC805X
	bool "Telechips TCC805x SoC Family"
	select ARM_SMCCC
	select USE_IRQ
	select HAS_SUBCORE

config TCC807X
	bool "Telechips TCC807x SoC Family"
	select ARM_SMCCC
	select USE_IRQ
	select HAS_SUBCORE

endchoice

choice
	prompt "Telechips SoC target core select"
	default USE_MAINCORE

config USE_MAINCORE
	bool "Telechips SoC main core"

config USE_SUBCORE
	bool "Telechips SoC sub-core"
	depends on HAS_SUBCORE

endchoice

config ARCH_REBOOT_INIT
	bool "Call arch-specific reboot init"
	default n

config TCC_SECUREBOOT
	bool "Support Telechips Secure Boot"
	default y

config TCC_SECUREBOOT_ENABLE
	bool "Secure Boot Enable"
	depends on TCC_SECUREBOOT && USE_MAINCORE
	default y

config TCC_MCERT_UNIQUEKEY_ENC
	bool "MCERT is encrypted the unique key"
	depends on TCC_SECUREBOOT && USE_MAINCORE
	default y

source "arch/arm/mach-telechips/tcc750x/Kconfig"
source "arch/arm/mach-telechips/tcc803x/Kconfig"
source "arch/arm/mach-telechips/tcc805x/Kconfig"
source "arch/arm/mach-telechips/tcc807x/Kconfig"

endmenu
```

## arch/arm/mach-telechips/tcc750x/Kconfig
```kconfig
# SPDX-License-Identifier: GPL-2.0-or-later
#
# Copyright (C) 2023 Telechips Inc.

if TCC750X

config SYS_SOC
	default "tcc750x"

config SYS_CONFIG_NAME
	default "tcc750x"

config SYS_BOARD
	default "tcc750x_evb"

source "board/telechips/tcc750x_evb/Kconfig"

endif
```

## arch/arm/mach-telechips/tcc803x/Kconfig
```kconfig
# SPDX-License-Identifier: GPL-2.0-or-later
#
# Copyright (C) 2023 Telechips Inc.

if TCC803X

config SYS_SOC
	default "tcc803x"

config SYS_CONFIG_NAME
	default "tcc803x"

config SYS_BOARD
	default "tcc803x_evb"

config USE_CORE_RESET
	bool "TCC803x Core Reset feature"
	default n

config BOOT_SUBCORE_BY_MAINCORE
	bool "Boot subcore kernel by maincore"
	default n

config INIT_SUBCORE_SERIAL_BY_MAINCORE
	bool "Init subcore serial by maincore"
	depends on BOOT_SUBCORE_BY_MAINCORE
	default y

source "board/telechips/tcc803x_evb/Kconfig"

endif
```

## arch/arm/mach-telechips/tcc805x/Kconfig
```kconfig
# SPDX-License-Identifier: GPL-2.0-or-later
#
# Copyright (C) 2023 Telechips Inc.

if TCC805X

config SYS_SOC
	default "tcc805x"

config SYS_CONFIG_NAME
	default "tcc805x"

config SYS_BOARD
	default "tcc805x_evb"

source "board/telechips/tcc805x_evb/Kconfig"

endif
```

## arch/arm/mach-telechips/tcc807x/Kconfig
```kconfig
# SPDX-License-Identifier: GPL-2.0-or-later
#
# Copyright (C) 2023 Telechips Inc.

if TCC807X

config SYS_SOC
	default "tcc807x"

config SYS_CONFIG_NAME
	default "tcc807x"

config SYS_BOARD
	default "tcc807x_evb"

source "board/telechips/tcc807x_evb/Kconfig"

endif
```

## board/telechips/common/Kconfig
```kconfig
if ARCH_TELECHIPS

config TCC_CMDLINE
	bool "Telechips Android Command Line Support"
	select ANDROID_BOOTLOADER
	default y

endif
```

## board/telechips/tcc805x_evb/Kconfig
```kconfig
# SPDX-License-Identifier: GPL-2.0-or-later
#
# Copyright (C) 2023 Telechips Inc.

if TCC805X

config POWERVR_VZ
	bool "PowerVR 9XTP Virtualization Support"
	default n
	
endif
```

## board/telechips/tcc807x_evb/Kconfig
```kconfig
# SPDX-License-Identifier: GPL-2.0-or-later
#
# Copyright (C) 2023 Telechips Inc.

if TCC807X

config MALI_VZ
        bool "ARM MALI-G78AE Virtualization Support"
        default n

endif
```

## cmd/tcc/Kconfig
```kconfig
menu "Telechips specific command line interface"
	depends on ARCH_TELECHIPS

config CMD_TCC_AVM
	bool "avm - Command to boot TCC803x subcore (Cortex-A7)"
	depends on BOOT_SUBCORE_BY_MAINCORE
	default y if TCC803X

config CMD_TCC_BLKREAD
	bool "blkread - Command to read partition or image from block devices"
	depends on PARTITIONS
	default y

config CMD_TCC_ECID
	bool "Read commands for TCC ECID"

config CMD_TCC_THERMAL
	bool "Test commands for TCC Thermal sensor"

config CMD_TCC_MEM
	bool "Enable commands for TCC DRAM test"

config CMD_TCC_SYNC
	bool "sync - Command to sync main/subcore for Telechips platform"
	depends on BOOT_SUBCORE_BY_MAINCORE
	default y if TCC805X

config CMD_TCC_TIMER_TEST
	bool "timer_test - Command to do TCC timer test"
	default n
	help
	  Enable 'timer_test' command for testing the timer interrupt and udelay.

config CMD_TCC_WDT
	bool "Enable commands for TCC watchdog timer"
	depends on WDT
	help
	  This command provide to control TCC watchdog timer.

config CMD_TEST_GPIO
	bool "test telechips GPIO"
	default n
	depends on PINCTRL
	help
	 test GPIO

config CMD_TCC_OTP
	bool "Enable commands for TCC OTP Wrapper"
	help
	  This command provide to control tcc OTP wrapper.

config CMD_TCC_OPTEE
	bool "Commands for management OPTEE"
	depends on OPTEE
	help
	  Smaller management cmd for Telechips OPTEE.

config CMD_TCC_PWM
	bool "Enable commands for TCC PWM"
	help
	  This command provide to control tcc PWM.

config CMD_TCC_MMC_TUNING
	bool "Enable commands for TCC MMC Tuning"
	depends on MMC_SDHCI
	help
	  This command provide to tune TCC MMC signals.

config CMD_TCC_PROC_RST
	bool "Enable commands for TCC Processor reset"
	help
	  This command provides to test TCC processor reset for CA72, CA53

config CMD_TCC_CLK_SHOW
	bool "This command shows TCC805x PLL and BUS Clock Frequency"
	default n
	help
	  This command provides to show TCC805x PLL and BUS Clock Frequency.

config CMD_TCC_CLK_CHANGER
	bool "This command provides clock frequency configuration method on CPU, GPU"
	depends on TCC805X
	default y
	help
	  This command provides to change CPU and GPU clock frequency on Telechips System.

config CMD_DWC_HOSTLIB
	bool "HDCP DP test without host library"
	depends on DISPLAY_PORT_V14
	help
	  This command provided to test HDCP DP without Host Library

endmenu
```

## cmd/telechips/Kconfig
```kconfig
# SPDX-License-Identifier: GPL-2.0-or-later
#
# Copyright (C) 2023 Telechips Inc.

menu "Telechips commands"
	depends on ARCH_TELECHIPS

config CMD_BLKREAD
	bool "blkread - Command to read partitions or images from block device"
	depends on PARTITIONS
	default y

config CMD_BOOT_SUBCORE
	bool "boot_subcore - Command to boot sub-core system"
	depends on BOOT_SUBCORE_BY_MAINCORE
	default y

config CMD_TIMER_TEST
	bool "timer_test - Command to do Telechips timer test"
	default n
	help
	  Enable 'timer_test' command for testing the timer interrupt and udelay.

config CMD_TCC_SECURE_BOOT
	bool "Command for TCC secureboot"
	depends on TCC_SECUREBOOT && USE_MAINCORE
	default y
	help
	  This command is for Telechips Secure Boot.

config CMD_TCC_OTP
	bool "Enable commands for TCC OTP Wrapper"
	depends on USE_MAINCORE && (TCC805X || TCC803X)
	select MISC
	select TCC_OTP
	default y
	help
	  This command provide to control tcc OTP wrapper.

config CMD_TCC_OTP3
	bool "Enable commands for TCC OTP Wrapper"
	depends on USE_MAINCORE && !(TCC805X || TCC803X)
	select MISC
	select TCC_OTP
	default y
	help
	  This command provide to control tcc OTP wrapper.

config CMD_TCC_OPTEE
	bool "Commands for management OPTEE"
	default n
	depends on OPTEE
	help
	  Smaller management cmd for Telechips OPTEE.

config CMD_TCC_TZC
	bool "Command for test TZC"
	help
	  This command for TZC (with secure wrapper) test"

config CMD_TCC_SMEM
	bool "Enable commands for TCC Memory Read/Write for Dev"
	default y
	help
	  This command for Memroy Read/Write for Dev.

config CMD_CLK_CHANGER
	bool "This command provides clock frequency configuration method on CPU, GPU"
	depends on TCC805X
	default y
	help
	  This command provides to change CPU and GPU clock frequency on Telechips System.

config CMD_TCC_PWM
	bool "Enable commands for TCC PWM"
	help
	  This command provide to control tcc PWM.

config CMD_TCC_MMC_TUNING
	bool "Enable commands for TCC MMC Tuning"
	depends on MMC_SDHCI
	select MMC_TCC_NO_RETRY_INIT
	help
	  This command provide to tune TCC MMC signals.

config CMD_TCC_CAN_TEST
	bool "CAN test driver"
	default n
	help
	  CAN test driver

config CMD_TEST_GPIO
	bool "test telechips GPIO"
	default n
	depends on PINCTRL
	help
	 test GPIO

config CMD_TCC_PCIE_SIGTEST
	bool "sigtest - Command to control PCIe Signal Quality"
	depends on PCIE_TELECHIPS
	default n
	select GETOPT

endmenu
```

## configs/tcc750x_defconfig
```kconfig
CONFIG_ARM=y
CONFIG_ARCH_TELECHIPS=y
CONFIG_SYS_TEXT_BASE=0x30000000
CONFIG_DM_GPIO=y
CONFIG_DEFAULT_DEVICE_TREE="telechips/tcc750x/tcc7500-lpd4x321"
CONFIG_TCC750X=y
# CONFIG_SYS_MALLOC_CLEAR_ON_INIT is not set
CONFIG_SYS_LOAD_ADDR=0x24000000
# CONFIG_LEGACY_IMAGE_FORMAT is not set
CONFIG_SHOW_BOOT_PROGRESS=y
CONFIG_SD_BOOT=y
# CONFIG_DISPLAY_CPUINFO is not set
CONFIG_HUSH_PARSER=y
CONFIG_CMD_DM=y
CONFIG_CMD_GPT=y
CONFIG_CMD_GPT_RENAME=y
CONFIG_CMD_I2C=y
CONFIG_CMD_MMC=y
CONFIG_CMD_PART=y
CONFIG_CMD_MII=y
CONFIG_CMD_PING=y
CONFIG_CMD_EXT2=y
CONFIG_CMD_EXT4=y
CONFIG_CMD_EXT4_WRITE=y
CONFIG_CMD_FAT=y
CONFIG_CMD_FS_GENERIC=y
CONFIG_NET_RANDOM_ETHADDR=y
CONFIG_CLK=y
CONFIG_CLK_TELECHIPS=y
CONFIG_CLK_TELECHIPS_DM=y
CONFIG_CPU=y
CONFIG_CPU_ARM_CORTEX=y
CONFIG_UDP_FUNCTION_FASTBOOT=y
CONFIG_FASTBOOT_BUF_ADDR=0x20000000
CONFIG_FASTBOOT_BUF_SIZE=0xA000000
CONFIG_FASTBOOT_FLASH=y
CONFIG_FASTBOOT_FLASH_MMC_DEV=0
CONFIG_TCC_DM_GPIO=y
CONFIG_DM_IRQ=y
CONFIG_DM_I2C=y
CONFIG_I2C_SET_DEFAULT_BUS_NUM=y
CONFIG_TCC_I2C=y
CONFIG_SUPPORT_EMMC_RPMB=y
CONFIG_MMC_HS400_ES_SUPPORT=y
CONFIG_MMC_HS400_SUPPORT=y
CONFIG_MMC_SDHCI=y
CONFIG_MMC_SDHCI_SDMA=y
CONFIG_MMC_SDHCI_TCC=y
CONFIG_PHY_REALTEK=y
CONFIG_DM_ETH=y
CONFIG_PHY_GIGE=y
CONFIG_ETH_DESIGNWARE_GMAC4=y
CONFIG_PINCTRL=y
CONFIG_PINCTRL_TELECHIPS=y
CONFIG_DM_PMIC=y
CONFIG_PMIC_I2C_SIMPLE=y
CONFIG_DM_SERIAL=y
CONFIG_PL01X_SERIAL=y
CONFIG_SYSRESET=y
CONFIG_SYSRESET_PSCI=y
CONFIG_TEE=y
CONFIG_OPTEE=y
CONFIG_TCC_HSM_FIRMWARE=y
CONFIG_DM_MAILBOX=y
CONFIG_SSS_MBOX=y
# CONFIG_EFI_LOADER is not set
# CONFIG_TOOLS_LIBCRYPTO is not set
```

## configs/tcc805x_android_p_defconfig
```kconfig
CONFIG_ARM=y
CONFIG_ARCH_TELECHIPS=y
CONFIG_SYS_TEXT_BASE=0x30000000
CONFIG_NR_DRAM_BANKS=2
CONFIG_DEBUG_UART_BASE=0x16600000
CONFIG_DEBUG_UART_CLOCK=48000000
CONFIG_TCC805X=y
CONFIG_DEBUG_UART=y
# CONFIG_SYS_MALLOC_CLEAR_ON_INIT is not set
CONFIG_SD_BOOT=y
# CONFIG_CONSOLE_MUX is not set
CONFIG_ANDROID_SYSTEM_AS_ROOT=y
CONFIG_BOARD_EARLY_INIT_F=y
CONFIG_HUSH_PARSER=y
CONFIG_AUTOBOOT_KEYED=y
CONFIG_AUTOBOOT_MENU_SHOW=y
CONFIG_CMD_BOOTMENU=y
CONFIG_CMD_DTIMG=y
CONFIG_CMD_BCB=y
CONFIG_CMD_DM=y
CONFIG_CMD_GPT=y
CONFIG_CMD_GPT_RENAME=y
CONFIG_CMD_I2C=y
CONFIG_CMD_MMC=y
# CONFIG_CMD_MMC_RPMB is not set
CONFIG_CMD_PART=y
# CONFIG_CMD_PINMUX is not set
CONFIG_CMD_USB=y
CONFIG_CMD_USB_MASS_STORAGE=y
CONFIG_CMD_BOOT_ANDROID=y
CONFIG_CMD_BMP=y
CONFIG_CMD_TCC_OTP=y
CONFIG_CMD_TCC_OPTEE=y
CONFIG_CMD_EXT2=y
CONFIG_CMD_EXT4=y
CONFIG_CMD_EXT4_WRITE=y
CONFIG_CMD_FAT=y
CONFIG_CMD_FS_GENERIC=y
CONFIG_DEFAULT_DEVICE_TREE="tcc8050-evb_sv1.0"
CONFIG_ENV_IS_IN_MMC=y
# CONFIG_NET is not set
CONFIG_REGMAP=y
CONFIG_CLK=y
CONFIG_CLK_TCC=y
CONFIG_CLK_TCC_DM=y
CONFIG_CPU=y
CONFIG_CPU_ARM_CORTEX=y
CONFIG_USB_FUNCTION_FASTBOOT=y
CONFIG_FASTBOOT_BUF_ADDR=0x20000000
CONFIG_FASTBOOT_BUF_SIZE=0xA000000
CONFIG_FASTBOOT_FLASH=y
CONFIG_FASTBOOT_FLASH_MMC_DEV=0
CONFIG_TCC_SC_FIRMWARE=y
CONFIG_DM_GPIO=y
CONFIG_TCC_DM_GPIO=y
CONFIG_TCC_GPIO=y
CONFIG_TCC_GPIO_SCFW=y
CONFIG_DM_PCA953X=y
CONFIG_DM_I2C=y
CONFIG_I2C_SET_DEFAULT_BUS_NUM=y
CONFIG_TCC_I2C=y
CONFIG_DM_IRQ=y
CONFIG_DM_MAILBOX=y
CONFIG_TCC_MBOX=y
CONFIG_MISC=y
CONFIG_PWRSEQ=y
CONFIG_SUPPORT_EMMC_RPMB=y
CONFIG_MMC_HS400_SUPPORT=y
CONFIG_MMC_TCC_SC=y
CONFIG_PHY=y
CONFIG_TELECHIPS_DWC2_PHY=y
CONFIG_TELECHIPS_DWC3_PHY=y
CONFIG_TELECHIPS_EHCI_PHY=y
CONFIG_PINCTRL=y
# CONFIG_PINCTRL_GENERIC is not set
# CONFIG_PINCONF_RECURSIVE is not set
CONFIG_PINCTRL_TELECHIPS=y
CONFIG_PINCTRL_TCC_SCFW=y
CONFIG_DM_PMIC=y
CONFIG_PMIC_DA9131=y
CONFIG_SPECIFY_CONSOLE_INDEX=y
CONFIG_CONS_INDEX=0
CONFIG_DM_SERIAL=y
CONFIG_DEBUG_UART_PL011=y
CONFIG_PL01X_SERIAL=y
CONFIG_SYSRESET=y
CONFIG_SYSRESET_PSCI=y
CONFIG_TEE=y
CONFIG_OPTEE=y
# CONFIG_OPTEE_TA_AVB is not set
CONFIG_USB=y
CONFIG_DM_USB=y
CONFIG_DM_USB_GADGET=y
CONFIG_USB_XHCI_HCD=y
CONFIG_USB_EHCI_HCD=y
CONFIG_USB_EHCI_GENERIC=y
CONFIG_USB_DWC3=y
CONFIG_USB_DWC3_GENERIC=y
CONFIG_USB_STORAGE=y
CONFIG_USB_KEYBOARD=y
CONFIG_USB_KEYBOARD_FN_KEYS=y
CONFIG_USB_GADGET=y
CONFIG_USB_GADGET_MANUFACTURER="Telechips"
CONFIG_USB_GADGET_VENDOR_NUM=0x18D1
CONFIG_USB_GADGET_PRODUCT_NUM=0xD00D
CONFIG_USB_GADGET_DWC2_OTG=y
CONFIG_DISPLAY_OUTPUT_PATH_DC0=y
CONFIG_SYS_WHITE_ON_BLACK=y
CONFIG_CONSOLE_SCROLL_LINES=10
CONFIG_LCD=y
CONFIG_HEXDUMP=y
CONFIG_OF_LIBFDT_OVERLAY=y
# CONFIG_EFI_LOADER is not set
```

## configs/tcc805x_subcore_defconfig
```kconfig
CONFIG_ARM=y
CONFIG_ARCH_TELECHIPS=y
CONFIG_SYS_TEXT_BASE=0x50000000
CONFIG_DM_GPIO=y
CONFIG_DEFAULT_DEVICE_TREE="telechips/tcc805x/tcc8050-subcore-lpd4x322-sv1.0"
CONFIG_TCC805X=y
CONFIG_USE_SUBCORE=y
# CONFIG_SYS_MALLOC_CLEAR_ON_INIT is not set
CONFIG_SYS_LOAD_ADDR=0x44000000
# CONFIG_LEGACY_IMAGE_FORMAT is not set
CONFIG_SHOW_BOOT_PROGRESS=y
# CONFIG_DISPLAY_CPUINFO is not set
CONFIG_HUSH_PARSER=y
CONFIG_CMD_DM=y
CONFIG_CMD_I2C=y
CONFIG_CMD_GPT=y
CONFIG_CMD_GPT_RENAME=y
CONFIG_CMD_PART=y
CONFIG_CMD_EXT2=y
CONFIG_CMD_EXT4=y
CONFIG_CMD_EXT4_WRITE=y
CONFIG_CMD_FAT=y
CONFIG_CMD_FS_GENERIC=y
# CONFIG_NET is not set
CONFIG_CLK=y
CONFIG_CLK_TELECHIPS=y
CONFIG_CLK_TELECHIPS_DM=y
CONFIG_CPU=y
CONFIG_CPU_ARM_CORTEX=y
CONFIG_TCC_SC_FIRMWARE=y
CONFIG_TCC_HSM_FIRMWARE=y
CONFIG_TCC_DM_GPIO=y
CONFIG_DM_IRQ=y
CONFIG_DM_I2C=y
CONFIG_I2C_SET_DEFAULT_BUS_NUM=y
CONFIG_TCC_I2C=y
CONFIG_DM_MAILBOX=y
CONFIG_TCC_MBOX=y
CONFIG_PINCTRL=y
CONFIG_PINCTRL_TELECHIPS=y
CONFIG_PINCTRL_TCC_SCFW=y
CONFIG_DM_PMIC=y
CONFIG_DM_SERIAL=y
CONFIG_PL01X_SERIAL=y
CONFIG_SYSRESET=y
CONFIG_SYSRESET_PSCI=y
# CONFIG_EFI_LOADER is not set
# CONFIG_TOOLS_LIBCRYPTO is not set
```

## drivers/camera/Kconfig
```kconfig
config EARLYCAMERA_SOLUTION
	bool "Enable EarlyCamera Solution"
	default n
	---help---
	Enable EarlyCamera Solution

	Note that you can use two sub-functions
	- controller list of earlycamera
	- timer interrupt to check status of reverse switch

config EARLYCAMERA_SOLUTION_CONTROLLED_BY_BOOTLOADER
	bool "Controlled by Bootloader"
	depends on EARLYCAMERA_SOLUTION
	default y
	---help---
	Controlled by Bootloader

	Note that you can select controller of earlycamera
	- controlled by main core
	- controlled by sub-core

config EARLYCAMERA_SOLUTION_TIME_MS
        int "Switch Status Check Timer in Milli-seconds"
        depends on EARLYCAMERA_SOLUTION && EARLYCAMERA_SOLUTION_CONTROLLED_BY_BOOTLOADER && !TCC803X
        default 100
	---help---
	Check timer period setting for switch state during early camera operation.

	Note that you can check status of reverse switch
	- use polling method instead of interrupt
	- period is 100ms in default

if EARLYCAMERA_SOLUTION
menu "Select Video Sources"
source "drivers/camera/earlycam/dev/Kconfig"
endmenu
endif # EARLYCAMERA_SOLUTION

config EARLYCAMERA_SOLUTION_OVERLAY_PGL
	bool "Support Parking Guide Line"
	depends on EARLYCAMERA_SOLUTION
	default n
	---help---
	Support Parking Guide Line

	Note that you can enable static parking guide line
	- static parking guide line is supported only
	- static parking guide line is a kind of splash image
```
