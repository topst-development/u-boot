## drivers/camera/earlycam/dev/Kconfig
```kconfig
comment "Select Video Decoder(s)"

config EARLYCAMERA_SOLUTION_VIDEODECODER_ANALOGDEVICES_ADV7182
	bool "Analog Devices - ADV7182"
	default n
	help
	Analog Devices - ADV7182

	Product details are belows
	- Manufacturer: Analog Devices
	- Product: ADV7182

config EARLYCAMERA_SOLUTION_VIDEODECODER_INTERSIL_ISL79988
	bool "Intersil - ISL79988"
	default n
	help
	Intersil - ISL79988

	Product details are belows
	- Manufacturer: Intersil
	- Product: ISL79988

config EARLYCAMERA_SOLUTION_DESERIALIZER_MAXIM_MAX9276
	bool "MAXIM - MAX9276"
	help
	MAXIM - MAX9276

	Product details are belows
	- Manufacturer: MAXIM
	- Product: MAX9276
```

## drivers/displayport/Kconfig
```kconfig
config DISPLAY_PORT_V14
	bool "Enable DisplayPort V1.4support"
	default y
	depends on TELECHIPS_FB_DM && (TCC805X || TCC807X)
	help
	   DisplayPort is a standard widely used in laptops to drive LCD panels.
	   This property provides DP V1.4 support where it's supported by the video hardware.
```

## drivers/firmware/Kconfig
```kconfig
config FIRMWARE
	bool "Enable Firmware driver support"

config SPL_FIRMWARE
	bool "Enable Firmware driver support in SPL"
	depends on FIRMWARE

config SPL_ARM_PSCI_FW
	bool
	select SPL_FIRMWARE

config ARM_PSCI_FW
	bool
	select FIRMWARE

config TI_SCI_PROTOCOL
	tristate "TI System Control Interface (TISCI) Message Protocol"
	depends on K3_SEC_PROXY
	select FIRMWARE
	select SPL_FIRMWARE if SPL
	help
	  TI System Control Interface (TISCI) Message Protocol is used to manage
	  compute systems such as ARM, DSP etc with the system controller in
	  complex System on Chip (SoC) such as those found on certain K3
	  generation SoC from TI.

	  This protocol library is used by client drivers to use the features
	  provided by the system controller.

config ZYNQMP_FIRMWARE
	bool "ZynqMP Firmware interface"
	select FIRMWARE
	help
	  Firmware interface driver is used by different
	  drivers to communicate with the firmware for
	  various platform management services.
	  Say yes to enable ZynqMP firmware interface driver.
	  If in doubt, say N.

source "drivers/firmware/scmi/Kconfig"

config TCC_SC_FIRMWARE
	bool "Telechips Storage Core Firmware interface"
	depends on ARCH_TELECHIPS
	depends on TCC_MBOX
	select FIRMWARE
	help
	  Telechips Storage Core Firmware Interface Messaage Protocol.

config TCC_HSM_FIRMWARE
	bool "Telechips HSM Firmware interface"
	depends on ARCH_TELECHIPS
	depends on TCC_MBOX || SSS_MBOX
	select FIRMWARE
	help
	  Telechips HSM Firmware Interface Messaage Protocol.

config TCC_THSM_FIRMWARE
	bool "Telechips THSM Firmware (TF-A EL3) interface"
	depends on ARCH_TELECHIPS
	select FIRMWARE
	help
	  Telechips THSM Firmware (TF-A EL3) Interface Messaage Protocol.
```

## drivers/irqchip/Kconfig
```kconfig
#
# IRQ subsystem configuration
#

menu "IRQ support"
	depends on USE_IRQ

config DM_IRQ
	bool "Enable Driver Model for IRQ driver"
	depends on DM
	help
	  Enable driver mdoel for IRQ.

choice
	prompt "ARM Generic Interrupt Conroller"
	default ARM_GICV3 if TCC807X

config ARM_GIC
	bool "ARM GICv2 interrupt controller"
	depends on ARM && DM_IRQ
	help
	  Add support for ARM GICv2 interrupt controller.

config ARM_GICV3
	bool "ARM GICv3 interrupt controller"
	depends on ARM && DM_IRQ
	help
	  Add support for ARM GICv3 interrupt controller.

endchoice

endmenu
```

## drivers/phy/telechips/Kconfig
```kconfig
# SPDX-License-Identifier: GPL-2.0-or-later
#
# Copyright (C) Telechips Inc.
#

config PHY_SF_PCIE
	bool "Telechips Samsung Foundry PCIe PHY"
	depends on PHY && TCC807X
	help
	  Enable this to support the PCIe PHY on TCC807x SoCs.

config PHY_DWC_PCIE
	bool "Telechips Designware PCIe PHY"
	depends on PHY && (TCC805X || TCC750X)
	select REGMAP
	help
	  Enable this to support the PCIe PHY on TCC805x SoCs.
```

## drivers/tav/Kconfig
```kconfig
#
# Verify Tools for Telechips Application BSP Team configuration
#

config TCC_APPB_VERIFICATION
	bool "Support Verification Tools for Telechips Application BSP Team"
	depends on TCC899X || TCC803X || TCC805X
	help
	  This driver support verification tools for Telechips Application BSP Team
		Please Disable this unless you have right purpose
```

## drivers/timer_irq/Kconfig
```kconfig
menu "Timer Interrupt Support"

config DM_TIMER_IRQ
	bool "Enable driver model for timer interrupt drivers"
	depends on DM && ARCH_TELECHIPS
	default y
	help
	  Enable driver model for timer access. It uses the same API as
	  lib/time.c, but now implemented by the uclass. The first timer
	  will be used. The timer is usually a 32 bits free-running up
	  counter. There may be no real tick, and no timer interrupt.

endmenu
```

## drivers/ufs/Kconfig
```kconfig
menu "UFS Host Controller Support"

config UFS
	bool "Support UFS controllers"
	depends on DM_SCSI
	help
	  This selects support for Universal Flash Subsystem (UFS).
	  Say Y here if you want UFS Support.

config UFS_CORE
	bool "Support Legacy UFS Core"
	depends on UFS
	help
	  This selects support for Legacy UFS Core.
	  Say Y here if you want UFS Support.

config CADENCE_UFS
	bool "Cadence platform driver for UFS"
	depends on UFS
        help
	  This selects the platform driver for the Cadence UFS host
	  controller present on present TI's J721e devices.

config TI_J721E_UFS
	bool "Glue Layer driver for UFS on TI J721E devices"
	help
	  This selects the glue layer driver for Cadence controller
	  present on TI's J721E devices.

config TCC_UFS
	depends on UFS
	bool "Telechip UFS driver"
	help
	  This selects the platform driver for the Telechip UFS host
	  controller present on Telechips devices.

config TCC_SC_UFS
	bool "Telechips Storage Core UFS Proxy Driver"
	depends on ARCH_TELECHIPS
	depends on TCC_SC_FIRMWARE
	help
	  This selects the Telechips Storage Core UFS Proxy Driver.
	  Say Y here if you want to use UFS Proxy Driver.

config TCC_UFS_BOOT
	bool "Telechips UFS BOOTING"
	depends on ARCH_TELECHIPS
	depends on UFS
	help
		This selects the Telechips UFS Booting.

config SUPPORT_UFS_RPMB
    bool "Support UFS replay protected memory block (RPMB)"
	depends on DM_SCSI
	depends on TCC_SC_UFS
	depends on UFS
    help
      Enable support for reading, writing and programming the
      key for the Replay Protection Memory Block partition in UFS.

config SUPPORT_UFS_REFRESH
	bool "Support UFS Refresh Operation"
	depends on DM_SCSI
	depends on TCC_SC_UFS
	depends on UFS
    help
      This selects the TCC UFS Refresh Oeration.
      Say Y here if you want to use UFS Refresh Feature.

endmenu
```
