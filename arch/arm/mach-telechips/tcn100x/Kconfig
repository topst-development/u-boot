## arch/arm/mach-telechips/tcn100x/Kconfig
```kconfig
# SPDX-License-Identifier: GPL-2.0-or-later
#
# Copyright (C) 2023 Telechips Inc.

if TCN100X

config SYS_SOC
	default "tcn100x"

config SYS_CONFIG_NAME
	default "tcn100x"

config SYS_BOARD
	default "tcn100x_evb"

source "board/telechips/tcn100x_evb/Kconfig"

endif
```

## configs/tcn100x_defconfig
```kconfig
CONFIG_ARM=y
CONFIG_ARCH_TELECHIPS=y
CONFIG_SYS_TEXT_BASE=0x190000000
CONFIG_DM_GPIO=y
CONFIG_DEFAULT_DEVICE_TREE="telechips/tcn100x/tcn1000-lpd4x321"
CONFIG_TCN100X=y
# CONFIG_TCC_SECUREBOOT is not set
# CONFIG_SYS_MALLOC_CLEAR_ON_INIT is not set
CONFIG_SYS_LOAD_ADDR=0x184000000
# CONFIG_LEGACY_IMAGE_FORMAT is not set
CONFIG_SHOW_BOOT_PROGRESS=y
CONFIG_SD_BOOT=y
# CONFIG_DISPLAY_CPUINFO is not set
CONFIG_HUSH_PARSER=y
CONFIG_CMD_DM=y
CONFIG_CMD_GPT=y
CONFIG_CMD_GPT_RENAME=y
CONFIG_CMD_I2C=y
CONFIG_CMD_MMC=y
CONFIG_CMD_PART=y
# CONFIG_CMD_TCC_OTP3 is not set
CONFIG_CMD_EXT2=y
CONFIG_CMD_EXT4=y
CONFIG_CMD_EXT4_WRITE=y
CONFIG_CMD_FAT=y
CONFIG_CMD_FS_GENERIC=y
# CONFIG_NET is not set
CONFIG_REGMAP=y
CONFIG_ADC=y
CONFIG_TCC_ADC=y
CONFIG_CLK=y
CONFIG_CLK_TELECHIPS=y
CONFIG_CLK_TELECHIPS_DM=y
CONFIG_CPU=y
CONFIG_CPU_ARM_CORTEX=y
CONFIG_USB_FUNCTION_FASTBOOT=y
CONFIG_FASTBOOT_BUF_ADDR=0x180000000
CONFIG_FASTBOOT_BUF_SIZE=0xA000000
CONFIG_FASTBOOT_FLASH=y
CONFIG_FASTBOOT_FLASH_MMC_DEV=0
CONFIG_TCC_DM_GPIO=y
CONFIG_DM_I2C=y
CONFIG_TCC_I2C=y
CONFIG_MISC=y
CONFIG_SUPPORT_EMMC_RPMB=y
CONFIG_MMC_HS400_ES_SUPPORT=y
CONFIG_MMC_HS400_SUPPORT=y
CONFIG_MMC_SDHCI=y
CONFIG_MMC_SDHCI_ADMA=y
CONFIG_MMC_SDHCI_TCC=y
CONFIG_PHY=y
CONFIG_TELECHIPS_DWC2_PHY=y
CONFIG_PINCTRL=y
CONFIG_PINCTRL_TELECHIPS=y
CONFIG_DM_SERIAL=y
CONFIG_PL01X_SERIAL=y
CONFIG_SYSRESET=y
CONFIG_SYSRESET_PSCI=y
CONFIG_USB=y
CONFIG_DM_USB_GADGET=y
CONFIG_USB_GADGET=y
CONFIG_USB_GADGET_MANUFACTURER="Telechips"
CONFIG_USB_GADGET_VENDOR_NUM=0x18D1
CONFIG_USB_GADGET_PRODUCT_NUM=0xD00D
CONFIG_USB_GADGET_DWC2_OTG=y
CONFIG_USB_GADGET_DWC2_OTG_PHY_BUS_WIDTH_8=y
# CONFIG_EFI_LOADER is not set
# CONFIG_TOOLS_LIBCRYPTO is not set
```
